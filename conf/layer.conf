## conf/layer.conf
```bitbake
BBPATH .= ":${LAYERDIR}"

BBFILES += "${LAYERDIR}/recipes-*/*/*.bb \
            ${LAYERDIR}/recipes-*/*/*.bbappend"

BBFILE_COLLECTIONS += "hailo-apps"
BBFILE_PATTERN_hailo-apps = "^${LAYERDIR}/"
BBFILE_PRIORITY_hailo-apps = "6"

LAYERDEPENDS_hailo-apps = "core openembedded-layer meta-hailo-imx"
LAYERSERIES_COMPAT_hailo-apps = "scarthgap"
```
